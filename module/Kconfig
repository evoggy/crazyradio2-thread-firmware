## module/Kconfig
```kconfig
# Copyright (c) 2026 Bitcraze AB
#
# SPDX-License-Identifier: Apache-2.0 OR MIT

config CRAZYRADIO2_UF2_BOOTLOADER_RESET
	bool "Reset to the UF2 bootloader when the host asks for bootloader mode"
	depends on BOARD_CRAZYRADIO2 && OPENTHREAD
	default y
	select OPENTHREAD_PLATFORM_BOOTLOADER_MODE
	select REBOOT
	help
	  Handle the OpenThread reset to bootloader request (Spinel reset type
	  bootloader, "reset bootloader" in the OpenThread CLI) by restarting
	  into the Crazyradio 2.0 UF2 bootloader.
```

## tools/west.yml
```yaml
manifest:
  self:
    path: crazyradio2-thread-firmware

  remotes:
    - name: ncs
      url-base: https://github.com/nrfconnect

  projects:
    - name: nrf
      repo-path: sdk-nrf
      remote: ncs
      revision: v3.4.1
      import:
        name-allowlist:
          - zephyr
          - nrfxlib
          - openthread
          - mbedtls
          - oberon-psa-crypto
          - cmsis
          - cmsis_6
          - hal_nordic
          - segger
          - zcbor
```
